## CMakeLists.txt
```
cmake_minimum_required(VERSION 3.20.0)

set(DTC_OVERLAY_FILE "${CMAKE_CURRENT_SOURCE_DIR}/boards/nrf52840dk_nrf52840.overlay")

find_package(Zephyr REQUIRED HINTS $ENV{ZEPHYR_BASE})

project(heart-rate-monitor)

target_sources(app PRIVATE src/main.c)

zephyr_include_directories(include)
```

## prj.conf
```kconfig
# Copyright (c) 2021 Nordic Semiconductor ASA
# SPDX-License-Identifier: Apache-2.0
#
# This file contains selected Kconfig options for the application.

# Enable logging via RTT, and use deferred logging to minimize the impact on the application's performance.
CONFIG_LOG=y
CONFIG_LOG_BACKEND_UART=n
CONFIG_LOG_MODE_DEFERRED=y
CONFIG_USE_SEGGER_RTT=y
CONFIG_LOG_BACKEND_RTT=y

CONFIG_ADC=y
CONFIG_ADC_ASYNC=y

CONFIG_XD58C=y

CONFIG_MAIN_STACK_SIZE=2048
```

## boards/nrf52840dk_nrf52840.overlay
```dts
/*
 * SPDX-License-Identifier: Apache-2.0
 */

/ {
	zephyr,user {
		io-channels = <&adc 0>;
	};
};

&adc {
	#address-cells = <1>;
	#size-cells = <0>;
	status = "okay";
	channel@0 {
		reg = <0>;
		zephyr,gain = "ADC_GAIN_1_6";
		zephyr,reference = "ADC_REF_INTERNAL";
		zephyr,acquisition-time = <ADC_ACQ_TIME(ADC_ACQ_TIME_MICROSECONDS, 40)>;
		zephyr,input-positive = <NRF_SAADC_AIN1>; 
		zephyr,resolution = <12>;
		zephyr,oversampling = <4>;
	};
};
```

## src/main.c
```c
/*
 * SPDX-License-Identifier: Apache-2.0
 */

#include <app_version.h>
#include <lib/xd58c.h>
#include <zephyr/kernel.h>
#include <zephyr/logging/log.h>

LOG_MODULE_REGISTER(main, LOG_LEVEL_INF);

/**
 * @brief Callback function for ADC sequence completion.
 * @param dev Pointer to the ADC device.
 * @param sequence Pointer to the ADC sequence.
 * @param sampling_index Index of the current sampling.
 * @return The action to take after the callback.
 */
static enum adc_action _callback(const struct device *dev,
                                 const struct adc_sequence *sequence,
                                 uint16_t sampling_index) {
  int16_t raw = *(int16_t *)sequence->buffer;

  static int32_t dc = 0;
  dc = dc - (dc >> 5) + raw;
  int16_t ac = raw - (int16_t)(dc >> 5);

  LOG_INF("%d", ac);

  return ADC_ACTION_REPEAT;
}

int main(void) {

  LOG_INF("Heart Rate Monitor %s", APP_VERSION_STRING);

  int err = xd58c_init();
  if (err) {
    LOG_ERR("init XD58C (err %d)", err);
    return err;
  }

  xd58c_callback_set(_callback, NULL);

  err = xd58c_start();
  if (err) {
    LOG_ERR("start XD58C (err %d)", err);
    return err;
  }

  while (1) {
    k_sleep(K_SECONDS(1));
  }

  return 0;
}
```
